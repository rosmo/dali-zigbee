## main/Kconfig.projbuild
```kconfig
menu "Dali-Zigbee Configuration"

    config DALIZB_TX_PIN
        int "DALI TX GPIO pin"
        default 5
        help
            GPIO TX PIN for DALI bus.

    config DALIZB_RX_PIN
        int "DALI RX GPIO pin"
        default 4
        help
            GPIO TX PIN for DALI bus.

    config DALIZB_RESET_PIN
        int "Reset GPIO pin"
        default 6
        help
            Reset PIN.

    config DALIZB_WIFI
        bool "Connect to WiFi"
        default n
        help
            Connect to WiFi.

    config DALIZB_WIFI_SSID
        string "WiFi SSID"
        default "myssid"
        help
            SSID (network name) to connect to.

    config DALIZB_WIFI_PASSWORD
        string "WiFi Password"
        default "mypassword"
        help
            WiFi password (WPA or WPA2) o use.

    choice DALIZB_WIFI_SAE_MODE
        prompt "WPA3 SAE mode selection"
        default DALIZB_WPA3_SAE_PWE_BOTH
        help
            Select mode for SAE as Hunt and Peck, H2E or both.
        config DALIZB_WPA3_SAE_PWE_HUNT_AND_PECK
            bool "HUNT AND PECK"
        config DALIZB_WPA3_SAE_PWE_HASH_TO_ELEMENT
            bool "H2E"
        config DALIZB_WPA3_SAE_PWE_BOTH
            bool "BOTH"
    endchoice

    config DALIZB_WIFI_PW_ID
        string "PASSWORD IDENTIFIER"
        depends on DALIZB_WPA3_SAE_PWE_HASH_TO_ELEMENT|| DALIZB_WPA3_SAE_PWE_BOTH
        default ""
        help
            Password identifier for SAE H2E

    config DALIZB_MAXIMUM_RETRY
        int "Maximum retry"
        default 5
        help
            Set the Maximum retry to avoid station reconnecting to the AP unlimited when the AP is really inexistent.

    choice DALIZB_WIFI_SCAN_AUTH_MODE_THRESHOLD
        prompt "WiFi Scan auth mode threshold"
        default DALIZB_WIFI_AUTH_WPA2_WPA3_PSK
        help
            The weakest authmode to accept in the scan mode.
            This value defaults to DALIZB_WIFI_AUTH_WPA2_PSK incase password is present and DALIZB_WIFI_AUTH_OPEN is used.
            Please select DALIZB_WIFI_AUTH_WEP/DALIZB_WIFI_AUTH_WPA_PSK incase AP is operating in WEP/WPA mode.

        config DALIZB_WIFI_AUTH_OPEN
            bool "OPEN"
        config DALIZB_WIFI_AUTH_WEP
            bool "WEP"
        config DALIZB_WIFI_AUTH_WPA_PSK
            bool "WPA PSK"
        config DALIZB_WIFI_AUTH_WPA2_PSK
            bool "WPA2 PSK"
        config DALIZB_WIFI_AUTH_WPA_WPA2_PSK
            bool "WPA/WPA2 PSK"
        config DALIZB_WIFI_AUTH_WPA3_PSK
            bool "WPA3 PSK"
        config DALIZB_WIFI_AUTH_WPA2_WPA3_PSK
            bool "WPA2/WPA3 PSK"
        config DALIZB_WIFI_AUTH_WAPI_PSK
            bool "WAPI PSK"
    endchoice

    config DALIZB_UPDATE_URL
        string "Firmware update URL"
        default "http://someserver.localdomain/firmware.bin"
        help
            Firmware update URL.

    config DALIZB_LED_EMULATOR
        bool "Emulate effects using a few LEDs"
        default n
        help
            Emulate lighting effects with some LEDs in GPIOs.

    config DALIZB_LED_1_PIN
        int "LED 1 GPIO pin"
        default 17 
        help
            GPIO PIN for LED 1.

    config DALIZB_LED_2_PIN
        int "LED 2 GPIO pin"
        default 16
        help
            GPIO PIN for LED 2.

    config DALIZB_LED_3_PIN
        int "LED 3 GPIO pin"
        default 19
        help
            GPIO PIN for LED 3.

    config DALIZB_LED_4_PIN
        int "LED 4 GPIO pin"
        default 20
        help
            GPIO PIN for LED 4.

    config DALIZB_LED_5_PIN
        int "LED 5 GPIO pin"
        default 6
        help
            GPIO PIN for LED 5.
        
endmenu
```

## sdkconfig.defaults
```kconfig
#
# Partition Table
#
CONFIG_PARTITION_TABLE_CUSTOM=y
CONFIG_PARTITION_TABLE_CUSTOM_FILENAME="partitions.csv"
CONFIG_PARTITION_TABLE_FILENAME="partitions.csv"
CONFIG_PARTITION_TABLE_OFFSET=0x8000
CONFIG_PARTITION_TABLE_MD5=y
# end of Partition Table

#
# mbedTLS
#
CONFIG_MBEDTLS_HARDWARE_AES=n
CONFIG_MBEDTLS_HARDWARE_MPI=n
CONFIG_MBEDTLS_HARDWARE_SHA=n
CONFIG_MBEDTLS_CMAC_C=y
CONFIG_MBEDTLS_SSL_PROTO_DTLS=y
CONFIG_MBEDTLS_KEY_EXCHANGE_ECJPAKE=y
# end of TLS Key Exchange Methods

CONFIG_MBEDTLS_ECJPAKE_C=y
# end of mbedTLS

#
# Zboss
#
CONFIG_ZB_ENABLED=y
# CONFIG_ZB_ZCZR=y
CONFIG_ZB_ZED=y
CONFIG_ZB_RADIO_NATIVE=y

# end of Zboss
§
#
# IEEE802154
#
CONFIG_IEEE802154_RECEIVE_DONE_HANDLER=y
CONFIG_IEEE802154_RX_BUFFER_SIZE=100
# end of IEEE802154
# end of Component config

# CONFIG_GPIO_CTRL_FUNC_IN_IRAM=y
CONFIG_ESP_TIMER_SUPPORTS_ISR_DISPATCH_METHOD=y

CONFIG_LWIP_TCP_SYNMAXRTX=12
CONFIG_LWIP_TCP_MSS=1400
CONFIG_LWIP_TCP_SND_BUF_DEFAULT=65534
CONFIG_LWIP_TCP_WND_DEFAULT=5840

CONFIG_ESPTOOLPY_FLASHSIZE_4MB=y

CONFIG_WIFI_MANAGER_TASK_PRIORITY=5
CONFIG_WIFI_MANAGER_RETRY_TIMER=5000
CONFIG_WIFI_DEFAULT_STA_ONLY=1q
CONFIG_WIFI_DEFAULT_STA_POWER_SAVE=0
CONFIG_WIFI_MANAGER_AUTOSTART_AP=y
CONFIG_WIFI_MANAGER_MAX_RETRY_START_AP=3
CONFIG_WIFI_MANAGER_SHUTDOWN_AP_TIMER=60000
CONFIG_WEBAPP_LOCATION="/"
CONFIG_DEFAULT_AP_SSID="Design Light Five Fold"
CONFIG_DEFAULT_AP_SSID_HIDDEN=0
# CONFIG_WIFI_MANAGER_APPEND_MAC is not set
# CONFIG_USE_RANDOM_AP_PASSWORD is not set
CONFIG_DEFAULT_AP_PASSWORD=""
CONFIG_DEFAULT_AP_CHANNEL=1
CONFIG_MAX_AP_NUM=15
CONFIG_DEFAULT_AP_IP="10.10.0.1"
CONFIG_DEFAULT_AP_GATEWAY="10.10.0.1"
CONFIG_DEFAULT_AP_NETMASK="255.255.255.0"
CONFIG_DEFAULT_AP_MAX_CONNECTIONS=4
CONFIG_WIFI_MAX_AP_CONFIGS=10
CONFIG_DEFAULT_AP_BEACON_INTERVAL=100
CONFIG_HARDCODED_SSID=""
CONFIG_HARDCODED_PASSWORD=""
CONFIG_HTTP_APP_ENABLED=y
# CONFIG_WIFI_POWER_ADJUSTABLE is not set
CONFIG_WIFI_DEFAULT_STA_CONNECT_RETRY_CNT=0
CONFIG_WIFI_DEFAULT_STA_CONNECT_MIN_RSSI=-80
CONFIG_WIFI_MANAGER_INITIAL_RETRY_MS=2500
CONFIG_WIFI_MANAGER_MAX_RETRY_MS=15000
CONFIG_WIFI_MANAGER_RETRY_MULTIPLIER=2
CONFIG_WIFI_DEFAULT_AP_BANDWIDTH=1
CONFIG_WIFI_DEFAULT_STA_SCAN_METHOD=1
CONFIG_WIFI_DEFAULT_STA_SORT_METHOD=0
CONFIG_WIFI_DEFAULT_STA_RM_ENABLED=0
CONFIG_WIFI_DEFAULT_STA_BTM_ENABLED=0
CONFIG_WIFI_DEFAULT_STA_MBO_ENABLED=0
CONFIG_WIFI_DEFAULT_STA_FT_ENABLED=0
```
